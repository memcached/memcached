## linux-source-5.15.0/drivers/iio/addac/Kconfig
```kconfig
#
# ADC DAC drivers
#
# When adding new entries keep the list in alphabetical order

menu "Analog to digital and digital to analog converters"

config STX104
	tristate "Apex Embedded Systems STX104 driver"
	depends on PC104 && X86
	select ISA_BUS_API
	select GPIOLIB
	help
	  Say yes here to build support for the Apex Embedded Systems STX104
	  integrated analog PC/104 card.

	  This driver supports the 16 channels of single-ended (8 channels of
	  differential) analog inputs, 2 channels of analog output, 4 digital
	  inputs, and 4 digital outputs provided by the STX104.

	  The base port addresses for the devices may be configured via the base
	  array module parameter.

endmenu
```

## linux-source-5.15.0/drivers/media/pci/intel/Kconfig
```kconfig
config VIDEO_INTEL_IPU6
	tristate "Intel IPU driver"
	depends on ACPI
	depends on MEDIA_SUPPORT
	depends on MEDIA_PCI_SUPPORT
	select IOMMU_API
	select IOMMU_IOVA
	select X86_DEV_DMA_OPS if X86
	select VIDEOBUF2_DMA_CONTIG
	select V4L2_FWNODE
	select PHYS_ADDR_T_64BIT
	select COMMON_CLK
	help
	  This is the Intel imaging processing unit, found in Intel SoCs and
	  used for capturing images and video from a camera sensor.

	  To compile this driver, say Y here! It contains 3 modules -
	  intel_ipu6, intel_ipu6_isys and intel_ipu6_psys.

source "drivers/media/pci/intel/ipu3/Kconfig"
```

## linux-source-5.15.0/drivers/misc/ivsc/Kconfig
```kconfig
# SPDX-License-Identifier: GPL-2.0
# Copyright (c) 2021, Intel Corporation. All rights reserved.

config INTEL_VSC
	tristate "Intel VSC"
	select INTEL_MEI_VSC
	help
	  Add support of Intel Visual Sensing Controller (IVSC).

config INTEL_VSC_CSI
	tristate "Intel VSC CSI client"
	depends on INTEL_VSC
	select INTEL_MEI
	help
	  Add CSI support for Intel Visual Sensing Controller (IVSC).

config INTEL_VSC_ACE
	tristate "Intel VSC ACE client"
	depends on INTEL_VSC
	select INTEL_MEI
	help
	  Add ACE support for Intel Visual Sensing Controller (IVSC).

config INTEL_VSC_PSE
	tristate "Intel VSC PSE client"
	depends on DEBUG_FS
	select INTEL_MEI
	select INTEL_MEI_VSC
	help
	  Add PSE support for Intel Visual Sensing Controller (IVSC) to
	  expose debugging information in files under /sys/kernel/debug/.

config INTEL_VSC_ACE_DEBUG
	tristate "Intel VSC ACE debug client"
	depends on DEBUG_FS
	select INTEL_MEI
	select INTEL_MEI_VSC
	help
	  Add ACE debug support for Intel Visual Sensing Controller (IVSC)
	  to expose debugging information in files under /sys/kernel/debug/.
```

## linux-source-5.15.0/ubuntu/Kconfig
```kconfig
menu "Ubuntu Supplied Third-Party Device Drivers"


config UBUNTU_ODM_DRIVERS
	def_bool $(success,$(srctree)/debian/scripts/misc/arch-has-odm-enabled.sh $(DEB_ARCH))
	help
	  Turn on support for Ubuntu ODM supplied drivers

#
# NOTE: to allow drivers to be added and removed without causing merge
# collisions you should add new entries in the middle of the six lines
# of ## at the bottom of the list.  Always add three lines of ## above
# your new entry and maintain the six lines below.
#

##
##
##
source "ubuntu/ubuntu-host/Kconfig"
##
##
##
##
##
##

endmenu
```

## linux-source-5.15.0/ubuntu/ubuntu-host/Kconfig
```kconfig
config UBUNTU_HOST
	tristate "proc dir for exporting host data to containers"
	help
	  Creates an ubuntu-host directory in proc for providing data from
	  Ubuntu hosts to containers.
```
